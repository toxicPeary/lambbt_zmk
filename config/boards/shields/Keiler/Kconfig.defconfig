## config/boards/shields/Keiler/Kconfig.defconfig
```kconfig
if SHIELD_KEILER_DONGLE
config ZMK_KEYBOARD_NAME
    default "Keiler"

config ZMK_SPLIT_ROLE_CENTRAL
    default y

config ZMK_USB
    default y
endif

if SHIELD_KEILER_LEFT || SHIELD_KEILER_RIGHT || SHIELD_KEILER_DONGLE
config ZMK_SPLIT
    default y

config ZMK_BLE
    default y
endif
```

## config/west.yml
```yaml
manifest:
  remotes:
    - name: zmkfirmware
      url-base: https://github.com/petejohanson
    - name: dhruvinsh
      url-base: https://github.com/dhruvinsh
    # Additional modules containing boards/shields/custom code can be listed here as well
    # See https://docs.zephyrproject.org/3.2.0/develop/west/manifest.html#projects
  projects:
    - name: zmk
      remote: zmkfirmware
      revision: feat/pointers-move-scroll
      import: app/west.yml
    - name: zmk-tri-state
      remote: dhruvinsh
      revision: main
  self:
    path: config
```
